## conf/layer.conf
```bitbake
BBPATH .= ":${LAYERDIR}"

BBFILES += "${LAYERDIR}/recipes-*/*/*.bb \
            ${LAYERDIR}/recipes-*/*/*.bbappend"

BBFILE_COLLECTIONS += "meta-ls1046a-recovery"
BBFILE_PATTERN_meta-ls1046a-recovery = "^${LAYERDIR}/"
BBFILE_PRIORITY_meta-ls1046a-recovery = "10"

LAYERDEPENDS_meta-ls1046a-recovery = "core"
LAYERSERIES_COMPAT_meta-ls1046a-recovery = "scarthgap"
```

## conf/machine/gateway-dk.conf
```bitbake
#@TYPE: Machine
#@NAME: Gateway Development Kit
#@DESCRIPTION: Machine configuration for Gateway Development kit, based on NXP LS1046A

require conf/machine/include/arm/armv8a/tune-cortexa72.inc

# QorIQ-specific variables
MACHINE_SOCARCH = "cortexa72"
SOC_FAMILY = "qoriq:ls1046a"

MACHINE_FEATURES = "serial"

KERNEL_IMAGETYPE = "Image.gz"
KERNEL_DEVICETREE = "freescale/ls1046a-gateway.dk.dtb"

SERIAL_CONSOLES = "115200;ttyS0 115200;ttyAMA0"

PREFERRED_PROVIDER_virtual/kernel ?= "linux-ls1046a"

INITRAMFS_IMAGE = "recovery-image"
INITRAMFS_IMAGE_NAME = "recovery-image.rootfs"
INITRAMFS_IMAGE_BUNDLE = "1"
```
